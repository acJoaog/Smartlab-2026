// =========================
// Bibliotecas
// =========================
#include <Arduino.h>
#include <IRremoteESP8266.h>
#include <IRsend.h>
#include <WiFiClientSecure.h>
#include <PubSubClient.h>
#include <WiFi.h>

// =========================
// WIFI
// =========================
const char* ssid     = "CSI-Lab";
const char* password = "In@teLCS&I";

// =========================
// MQTT
// =========================
const char* mqttServer   = "192.168.66.11";
const char* mqttUser     = "smartlab";
const char* mqttPassword = "WhoAmI#2024";
const int   mqttPort     = 8883;

const char* mqttTopicSub = "smartlab/#";
const char* ID           = "smartlab-RadioCom";

// =========================
// IR - PINOS
// =========================
#define IR_PIN_AC  33
#define IR_PIN_TV  18

IRsend irAC(IR_PIN_AC);
IRsend irTV(IR_PIN_TV);

// =========================
// IR - COMANDOS TV LG (NEC)
// =========================
#define LG_POWER      0x20DF10EF
#define LG_MUTE       0x20DF906F
#define LG_VOL_UP     0x20DF40BF
#define LG_VOL_DOWN   0x20DFC03F
#define LG_CH_UP      0x20DF00FF
#define LG_CH_DOWN    0x20DF807F
#define LG_OK         0x20DF22DD
#define LG_UP         0x20DF02FD
#define LG_DOWN       0x20DF827D
#define LG_LEFT       0x20DFE01F
#define LG_RIGHT      0x20DF609F
#define LG_BACK       0x20DF14EB
#define LG_HOME       0x20DF3EC1
#define LG_INPUT      0x20DFD02F

// =========================
// IR - CÓDIGOS RAW AR COND.
// =========================
const int AC_RAW_LEN = 200;
const int AC_FREQ    = 38;

uint16_t AC_OFF[200]     = {4450, 4450, 550, 1650, 550, 600, 550, 1700, 550, 1650, 550, 600, 550,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 1700, 500};
uint16_t AC_17[200]      = {4400, 4450, 550, 1650, 550, 600, 550, 1700, 550, 1650, 550, 600, 550,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 1700, 500};
uint16_t AC_18[200]      = {4400, 4450, 550, 1700, 550, 600, 550, 1700, 550, 1700, 550, 600, 550,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 1700, 550};
uint16_t AC_19[200]      = {4400, 4450, 550, 1700, 550, 600, 550, 1700, 550, 1700, 550, 600, 550,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 1700, 550};
uint16_t AC_20[200]      = {4400, 4450, 550, 1700, 550, 600, 550, 1700, 550, 1700, 550, 600, 550,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 1700, 500};
uint16_t AC_21[200]      = {4450, 4400, 550, 1700, 550, 600, 550, 1700, 550, 1650, 550, 600, 550,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 1700, 550};
uint16_t AC_22[200]      = {4350, 4500, 550, 1700, 550, 600, 550, 1700, 550, 1700, 550, 600, 550,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 1700, 500};
uint16_t AC_23[200]      = {4400, 4450, 550, 1700, 550, 600, 550, 1700, 550, 1700, 550, 600, 550,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 1700, 500};
uint16_t AC_24[200]      = {4400, 4450, 550, 1700, 550, 600, 550, 1700, 550, 1700, 550, 600, 550,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 1700, 550};
uint16_t AC_25[200]      = {4400, 4450, 550, 1700, 550, 600, 550, 1700, 550, 1700, 550, 600, 550,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 1700, 500};
uint16_t AC_26[200]      = {4400, 4450, 550, 1700, 550, 600, 550, 1700, 550, 1700, 550, 600, 550,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 1700, 500};
uint16_t AC_27[200]      = {4400, 4450, 550, 1700, 550, 600, 550, 1700, 550, 1700, 550, 600, 550,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 1700, 500};
uint16_t AC_28[200]      = {4400, 4450, 550, 1700, 550, 600, 550, 1700, 550, 1700, 550, 600, 550,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 1700, 500};
uint16_t AC_29[200]      = {4400, 4450, 550, 1700, 550, 600, 550, 1700, 550, 1700, 550, 600, 550,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 1700, 500};
uint16_t AC_30[200]      = {4350, 4500, 550, 1700, 550, 600, 550, 1700, 550, 1700, 550, 600, 550,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 1700, 500};

// Tabela de lookup: índice 0 = 17°C, índice 13 = 30°C
uint16_t* AC_TEMP_TABLE[] = {
  AC_17, AC_18, AC_19, AC_20, AC_21, AC_22, AC_23,
  AC_24, AC_25, AC_26, AC_27, AC_28, AC_29, AC_30
};
const int AC_TEMP_MIN = 17;
const int AC_TEMP_MAX = 30;

// =========================
// INSTÂNCIAS
// =========================
WiFiClientSecure secureClient;
PubSubClient client(secureClient);

// =========================
// WIFI
// =========================
void connectWiFi() {
  Serial.print("Conectando ao WiFi");
  WiFi.begin(ssid, password);

  while (WiFi.status() != WL_CONNECTED) {
    delay(300);
    Serial.print(".");
  }

  Serial.println("\nWiFi conectado!");
  Serial.println(WiFi.localIP());
}

// =========================
// IR - AR CONDICIONADO
// =========================
void sendACRaw(uint16_t* data, int repeat = 1) {
  for (int i = 0; i < repeat; i++) {
    irAC.sendRaw(data, AC_RAW_LEN, AC_FREQ);
    delay(40);
  }
}

void processACCommand(int valor) {
  if (valor == 7) {
    sendACRaw(AC_OFF, 3);
    Serial.println("AC - Desligado");
  }
  else if (valor >= AC_TEMP_MIN && valor <= AC_TEMP_MAX) {
    sendACRaw(AC_TEMP_TABLE[valor - AC_TEMP_MIN]);
    Serial.printf("AC - Temperatura: %d°C\n", valor);
  }
  else {
    Serial.printf("AC - Comando invalido: %d\n", valor);
  }
}

// =========================
// IR - TV LG
// =========================
void sendTVCommand(uint32_t cmd, const char* nome, int repeat = 1) {
  for (int i = 0; i < repeat; i++) {
    irTV.sendNEC(cmd, 32);
    delay(120);
  }
  Serial.printf("TV LG - Comando enviado: %s\n", nome);
}

void processTVCommand(const String& msg) {
  if      (msg == "power")        sendTVCommand(LG_POWER,    "Power",        3);
  else if (msg == "mute")         sendTVCommand(LG_MUTE,     "Mute");
  else if (msg == "volume_up")    sendTVCommand(LG_VOL_UP,   "Volume +");
  else if (msg == "volume_down")  sendTVCommand(LG_VOL_DOWN, "Volume -");
  else if (msg == "channel_up")   sendTVCommand(LG_CH_UP,    "Canal +");
  else if (msg == "channel_down") sendTVCommand(LG_CH_DOWN,  "Canal -");
  else if (msg == "up")           sendTVCommand(LG_UP,       "Cima");
  else if (msg == "down")         sendTVCommand(LG_DOWN,     "Baixo");
  else if (msg == "left")         sendTVCommand(LG_LEFT,     "Esquerda");
  else if (msg == "right")        sendTVCommand(LG_RIGHT,    "Direita");
  else if (msg == "ok")           sendTVCommand(LG_OK,       "OK");
  else if (msg == "return")       sendTVCommand(LG_BACK,     "Voltar");
  else if (msg == "smart")        sendTVCommand(LG_HOME,     "Home/Smart");
  else if (msg == "source")       sendTVCommand(LG_INPUT,    "Source/Input");
  else Serial.printf("TV LG - Comando invalido: %s\n", msg.c_str());
}

// =========================
// CALLBACK MQTT
// =========================
void callback(char* topic, byte* payload, unsigned int length) {
  char message[length + 1];
  memcpy(message, payload, length);
  message[length] = '\0';

  Serial.printf("Mensagem recebida [%s]: %s\n", topic, message);

  String topicStr = String(topic);

  if (topicStr.startsWith("smartlab/arcond/set/2")) {
    // Valida payload numerico
    bool isNumeric = (length > 0);
    for (unsigned int i = 0; i < length; i++) {
      if (!isDigit(message[i])) { isNumeric = false; break; }
    }
    if (!isNumeric) {
      Serial.println("AC - Payload nao numerico.");
      return;
    }
    processACCommand(atoi(message));
  }
  else if (topicStr.startsWith("smartlab/tv/lg/")) {
    processTVCommand(String(message));
  }
  else {
    Serial.println("Topico nao reconhecido.");
  }
}

// =========================
// CONEXÃO MQTT
// =========================
void connectMQTT() {
  while (!client.connected()) {
    Serial.println("Conectando ao Broker MQTT...");

    if (client.connect(ID, mqttUser, mqttPassword)) {
      Serial.println("Conectado!");
      client.subscribe(mqttTopicSub);
      Serial.printf("Inscrito no topico: %s\n", mqttTopicSub);
    } else {
      Serial.print("Falha, rc=");
      Serial.println(client.state());
      delay(2000);
    }
  }
}

// =========================
// SETUP
// =========================
void setup() {
  Serial.begin(115200);

  irAC.begin();
  irTV.begin();

  connectWiFi();

  secureClient.setInsecure();
  client.setServer(mqttServer, mqttPort);
  client.setCallback(callback);

  Serial.println("Sistema pronto");
  Serial.println("Topicos: smartlab/arcond/set/<id> | smartlab/tv/lg/");
  Serial.println("AC: 7=Desligar, 17-30=Temperatura");
  Serial.println("TV: power, mute, volume_up/down, channel_up/down, up/down/left/right, ok, return, smart, source");
}

// =========================
// LOOP
// =========================
void loop() {
  if (WiFi.status() != WL_CONNECTED) {
    connectWiFi();
  }

  if (!client.connected()) {
    connectMQTT();
  }

  client.loop();
}