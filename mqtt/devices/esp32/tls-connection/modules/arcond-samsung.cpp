#include <WiFi.h>
#include <WiFiClientSecure.h>
#include <PubSubClient.h>
#include <ArduinoOTA.h>
#include <time.h>
#include <IRremoteESP8266.h>
#include <IRsend.h>

// =========================
// CONFIGURAÇÕES
// =========================
const char* ssid         = "CSI-Lab";
const char* password     = "In@teLCS&I";

const char* mqttServer   = "192.168.66.11";
const char* mqttUser     = "smartlab";
const char* mqttPassword = "WhoAmI#2024";
const int   mqttPort     = 8883;
const char* mqttTopicSub = "smartlab/#";
const char* ID           = "smartlab-ir";

#define IR_PIN    33
#define IR_PIN_TV 18

const int FREQ_KHZ    = 38;
const int LEN_ARCOND  = 200;
const int LEN_TV      = 68;

// =========================
// IR - CÓDIGOS RAW AR COND.
// =========================
const int AC_RAW_LEN = 200;
const int AC_FREQ    = 38;

uint16_t AC_OFF[200] = {4450, 4450, 550, 1650, 550, 600, 550, 1700, 550, 1650, 550, 600, 550,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 1700, 500};
uint16_t AC_17[200] = {4400, 4450, 550, 1650, 550, 600, 550, 1700, 550, 1650, 550, 600, 550,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 1700, 500};
uint16_t AC_18[200] = {4400, 4450, 550, 1700, 550, 600, 550, 1700, 550, 1700, 550, 600, 550,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 1700, 550};
uint16_t AC_19[200] = {4400, 4450, 550, 1700, 550, 600, 550, 1700, 550, 1700, 550, 600, 550,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 1700, 550};
uint16_t AC_20[200] = {4400, 4450, 550, 1700, 550, 600, 550, 1700, 550, 1700, 550, 600, 550,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 1700, 500};
uint16_t AC_21[200] = {4450, 4400, 550, 1700, 550, 600, 550, 1700, 550, 1650, 550, 600, 550,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 1700, 550};
uint16_t AC_22[200] = {4350, 4500, 550, 1700, 550, 600, 550, 1700, 550, 1700, 550, 600, 550,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 1700, 500};
uint16_t AC_23[200] = {4400, 4450, 550, 1700, 550, 600, 550, 1700, 550, 1700, 550, 600, 550,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 1700, 500};
uint16_t AC_24[200] = {4400, 4450, 550, 1700, 550, 600, 550, 1700, 550, 1700, 550, 600, 550,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 1700, 550};
uint16_t AC_25[200] = {4400, 4450, 550, 1700, 550, 600, 550, 1700, 550, 1700, 550, 600, 550,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 1700, 500};
uint16_t AC_26[200] = {4400, 4450, 550, 1700, 550, 600, 550, 1700, 550, 1700, 550, 600, 550,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 1700, 500};
uint16_t AC_27[200] = {4400, 4450, 550, 1700, 550, 600, 550, 1700, 550, 1700, 550, 600, 550,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 1700, 500};
uint16_t AC_28[200] = {4400, 4450, 550, 1700, 550, 600, 550, 1700, 550, 1700, 550, 600, 550,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 1700, 500};
uint16_t AC_29[200] = {4400, 4450, 550, 1700, 550, 600, 550, 1700, 550, 1700, 550, 600, 550,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 1700, 500};
uint16_t AC_30[200] = {4350, 4500, 550, 1700, 550, 600, 550, 1700, 550, 1700, 550, 600, 550,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 1700, 500};

// Tabela de lookup: índice 0 = 17°C, índice 13 = 30°C
uint16_t* AC_TEMP_TABLE[] = {
  AC_17, AC_18, AC_19, AC_20, AC_21, AC_22, AC_23,
  AC_24, AC_25, AC_26, AC_27, AC_28, AC_29, AC_30
};
const int AC_TEMP_MIN = 17;
const int AC_TEMP_MAX = 30;

// =========================
// SINAIS IR — TV SAMSUNG
// =========================
// Power
uint16_t TVO[68] = {4600, 4500, 650, 1700, 700, 1600, 600, 1700, 600, 550, 600, 550, 600,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 1700, 600};
// Up
uint16_t TVC[68] = {4600, 4550, 600, 1700, 600, 1700, 600, 1700, 600, 550, 600, 550, 600,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 1700, 600};
// Right
uint16_t TVD[68] = {4600, 4550, 600, 1700, 600, 1700, 600, 1700, 600, 600, 600, 550, 600,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 1700, 600};
// Left
uint16_t TVE[68] = {4600, 4500, 600, 1700, 600, 1700, 600, 1700, 600, 550, 600, 550, 600,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 1700, 600};
// Down
uint16_t TVB[68] = {4600, 4500, 600, 1700, 600, 1700, 600, 1700, 600, 550, 600, 550, 600,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 1700, 600};
// OK
uint16_t TVM[68] = {4600, 4550, 600, 1700, 600, 1700, 600, 1700, 600, 550, 600, 550, 600,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 1700, 600};
// Smart
uint16_t TVS[68] = {4600, 4550, 600, 1700, 600, 1700, 600, 1700, 600, 550, 600, 550, 600,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 1700, 600};
// Return
uint16_t TVR[68] = {4600, 4550, 600, 1700, 600, 1700, 600, 1700, 600, 550, 600, 550, 600,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 1700, 600};
// Volume Down
uint16_t TVVD[68] = {4600, 4500, 600, 1700, 600, 1700, 600, 1700, 600, 550, 600, 550, 600,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 1700, 600};
// Volume Up
uint16_t TVVA[68] = {4600, 4500, 600, 1700, 600, 1700, 600, 1700, 600, 550, 600, 550, 600,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 1700, 600};
// Mute
uint16_t TVW[68] = {4600, 4500, 600, 1700, 600, 1700, 600, 1700, 600, 600, 600, 600, 600,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 1700, 600};
// Source
uint16_t TVU[68] = {4600, 4550, 600, 1700, 600, 1700, 600, 1700, 600, 600, 600, 550, 600,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 1700, 600};
// Channel Down
uint16_t TVDC[68] = {4600, 4500, 600, 1700, 600, 1700, 600, 1700, 600, 600, 600, 550, 600,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 1700, 600};
// Channel Up
uint16_t TVAC[68] = {4550, 4550, 600, 1700, 600, 1700, 600, 1700, 600, 600, 600, 550, 600,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 1700, 600};


struct TvCommand {
  const char*  name;
  uint16_t*    signal;
};

TvCommand tvCommands[] = {
  { "power",        TVO  },
  { "up",           TVC  },
  { "down",         TVB  },
  { "left",         TVE  },
  { "right",        TVD  },
  { "ok",           TVM  },
  { "smart",        TVS  },
  { "return",       TVR  },
  { "volume_down",  TVVD },
  { "volume_up",    TVVA },
  { "mute",         TVW  },
  { "source",       TVU  },
  { "channel_up",   TVAC },
  { "channel_down", TVDC },
};
const int TV_COMMAND_COUNT = sizeof(tvCommands) / sizeof(tvCommands[0]);

// =========================
// INSTÂNCIAS
// =========================
IRsend irsend(IR_PIN);
IRsend irsend1(IR_PIN_TV);

WiFiClientSecure secureClient;
PubSubClient client(secureClient);

// =========================
// ESTADO DO AR-CONDICIONADO
// =========================
String acMode = "off";
int    acTemp = 23;

// =========================
// PROTÓTIPOS
// =========================
void connectMQTT();
void publishACState();
void processACMode(String mode);
void processACTemp(int temp);
void processTvCommands(const String& msg);

// =========================
// NTP
// =========================
void setClock() {
  configTime(-3 * 3600, 0, "pool.ntp.org");
  Serial.print("Sincronizando tempo");
  time_t now = time(nullptr);
  while (now < 1700000000) {
    delay(500);
    Serial.print(".");
    now = time(nullptr);
  }
  Serial.println("\nTempo OK");
}

// =========================
// MQTT — PUBLICAÇÃO DE ESTADO
// =========================
void publishACState() {
  char tempBuffer[4];
  snprintf(tempBuffer, sizeof(tempBuffer), "%d", acTemp);
  client.publish("smartlab/arcond/mode/state/1", acMode.c_str(), true);
  client.publish("smartlab/arcond/temp/state/1", tempBuffer, true);
  Serial.printf("Estado AC publicado -> mode: %s | temp: %d\n", acMode.c_str(), acTemp);
}

// =========================
// ENVIO IR
// =========================
void sendIRRaw(uint16_t* rawData, int rawLen, int repeatCount = 1) {
  for (int i = 0; i < repeatCount; i++) {
    irsend.sendRaw(rawData, rawLen, FREQ_KHZ);
    delay(40);
  }
}

// =========================
// IR - AR CONDICIONADO
// =========================
void sendACRaw(uint16_t* data, int repeat = 1) {
  for (int i = 0; i < repeat; i++) {
    irsend.sendRaw(data, AC_RAW_LEN, AC_FREQ);
    delay(40);
  }
}

void processACCommand(int valor) {
  if (valor == 7) {
    sendACRaw(AC_OFF, 3);
    Serial.println("AC - Desligado");
  }
  else if (valor >= AC_TEMP_MIN && valor <= AC_TEMP_MAX) {
    sendACRaw(AC_TEMP_TABLE[valor - AC_TEMP_MIN]);
    Serial.printf("AC - Temperatura: %d°C\n", valor);
  }
  else {
    Serial.printf("AC - Comando invalido: %d\n", valor);
  }
}

// =========================
// TV SAMSUNG
// =========================
void processTvCommands(const String& msg) {
  for (int i = 0; i < TV_COMMAND_COUNT; i++) {
    if (msg == tvCommands[i].name) {
      irsend1.sendRaw(tvCommands[i].signal, LEN_TV, FREQ_KHZ);
      Serial.printf("Comando TV enviado: %s\n", tvCommands[i].name);
      delay(50);
      return;
    }
  }
  Serial.printf("Comando TV inválido: %s\n", msg.c_str());
}

// =========================
// CALLBACK MQTT
// =========================
void callback(char* topic, byte* payload, unsigned int length) {
  char message[length + 1];
  memcpy(message, payload, length);
  message[length] = '\0';

  String topicStr = String(topic);
  String msgStr   = String(message);

  Serial.printf("Mensagem recebida [%s]: %s\n", topic, message);

  if (topicStr == "smartlab/arcond/set/1") {
    // Valida payload numerico
    bool isNumeric = (length > 0);
    for (unsigned int i = 0; i < length; i++) {
      if (!isDigit(message[i])) { isNumeric = false; break; }
    }
    if (!isNumeric) {
      Serial.println("AC - Payload nao numerico.");
      return;
    }
    processACCommand(atoi(message));
  } else if (topicStr.startsWith("smartlab/tv/samsung/")) {
    processTvCommands(msgStr);
  } else {
    Serial.println("Topico não reconhecido.");
  }
}

// =========================
// MQTT — CONEXÃO
// =========================
void connectMQTT() {
  while (!client.connected()) {
    Serial.println("Conectando ao Broker MQTT...");
    if (client.connect(ID, mqttUser, mqttPassword)) {
      Serial.println("Conectado!");
      client.subscribe(mqttTopicSub);
      Serial.printf("Inscrito no tópico: %s\n", mqttTopicSub);
      publishACState();
    } else {
      Serial.printf("Falha, rc=%d\n", client.state());
      delay(2000);
    }
  }
}

// =========================
// SETUP / LOOP
// =========================
void setup() {
  Serial.begin(115200);
  irsend.begin();
  irsend1.begin();

  WiFi.begin(ssid, password);
  while (WiFi.status() != WL_CONNECTED) {
    delay(300);
    Serial.print(".");
  }
  Serial.printf("\nWiFi conectado | IP: %s\n", WiFi.localIP().toString().c_str());

  setClock();

  secureClient.setInsecure();
  client.setServer(mqttServer, mqttPort);
  client.setCallback(callback);
  connectMQTT();

  ArduinoOTA.begin();
  Serial.println("OTA pronto");
}

void loop() {
  ArduinoOTA.handle();
  client.loop();
  if (!client.connected()) connectMQTT();
}